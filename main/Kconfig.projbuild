## main/Kconfig.projbuild
```kconfig
# @file Kconfig.projbuild
# @brief Project configuration options
#
# Defines configurable parameters for hardware pins, motor settings,
# WiFi credentials, and operational limits.

menu "Automatic Soldering Station Configuration"

    menu "WiFi Configuration"
        config WIFI_SSID
            string "WiFi SSID"
            default "SolderingStation"
            help
                SSID for the WiFi Access Point

        config WIFI_PASSWORD
            string "WiFi Password"
            default "soldering123"
            help
                Password for WiFi AP (min 8 characters)

        config WIFI_CHANNEL
            int "WiFi Channel"
            default 1
            range 1 13
            help
                WiFi channel for AP

        config WIFI_MAX_CONNECTIONS
            int "Maximum WiFi Connections"
            default 4
            range 1 4
            help
                Maximum number of simultaneous client connections
    endmenu

    menu "Stepper Motor Pins - X Axis"
        config MOTOR_X_STEP_PIN
            int "X-Axis Step Pin"
            default 21
            help
                GPIO pin for X-axis stepper STEP signal (D21)

        config MOTOR_X_DIR_PIN
            int "X-Axis Direction Pin"
            default 18
            help
                GPIO pin for X-axis stepper DIR signal (D18)

        config MOTOR_X_ENABLE_PIN
            int "X-Axis Enable Pin"
            default 25
            help
                GPIO pin for X-axis stepper ENABLE signal (D25)
        config MOTOR_X_MIN_ENDPOINT_PIN
            int "X-Axis Minimum Endstop Pin"
            default 12
            help
                GPIO pin for X-axis minimum endstop switch (D12)
        config MM_IN_MICROSTEP
            int "Millimeters per Microstep"
            default 0.04
            help
                Number of millimeters the X-axis moves per microstep
        config MICROSTEPS_IN_MM
            int "Microsteps per Millimeter"
            default 25
            help
                Number of microsteps required to move 1 millimeter
    endmenu

    menu "Stepper Motor Pins - Y Axis"
        config MOTOR_Y_STEP_PIN
            int "Y-Axis Step Pin"
            default 22
            help
                GPIO pin for Y-axis stepper STEP signal (D22)

        config MOTOR_Y_DIR_PIN
            int "Y-Axis Direction Pin"
            default 5
            help
                GPIO pin for Y-axis stepper DIR signal (D5)

        config MOTOR_Y_ENABLE_PIN
            int "Y-Axis Enable Pin"
            default 26
            help
                GPIO pin for Y-axis stepper ENABLE signal (D26)

        config MOTOR_Y_MIN_ENDPOINT_PIN
            int "Y-Axis Minimum Endstop Pin"
            default 13
            help
                GPIO pin for Y-axis minimum endstop switch (D13)
        config MM_IN_MICROSTEP
            int "Millimeters per Microstep"
            default 0.04
            help
                Number of millimeters the Y-axis moves per microstep
        config MICROSTEPS_IN_MM
            int "Microsteps per Millimeter"
            default 25
            help
                Number of microsteps required to move 1 millimeter
    endmenu

    menu "Stepper Motor Pins - Z Axis"
        config MOTOR_Z_STEP_PIN
            int "Z-Axis Step Pin"
            default 23
            help
                GPIO pin for Z-axis stepper STEP signal (D23)

        config MOTOR_Z_DIR_PIN
            int "Z-Axis Direction Pin"
            default 4
            help
                GPIO pin for Z-axis stepper DIR signal (D4)

        config MOTOR_Z_ENABLE_PIN
            int "Z-Axis Enable Pin"
            default 32
            help
                GPIO pin for Z-axis stepper ENABLE signal (D32)
        config MOTOR_Z_MIN_ENDPOINT_PIN
            int "Z-Axis Minimum Endstop Pin"
            default 14
            help
                GPIO pin for Z-axis minimum endstop switch (D14)
            
    endmenu

    menu "Stepper Motor Pins - Solder Supply"
        config MOTOR_S_STEP_PIN
            int "Solder Supply Step Pin"
            default 19
            help
                GPIO pin for solder supply stepper STEP signal (D19 - Extruder)

        config MOTOR_S_DIR_PIN
            int "Solder Supply Direction Pin"
            default 16
            help
                GPIO pin for solder supply stepper DIR signal (D16 - Extruder)

        config MOTOR_S_ENABLE_PIN
            int "Solder Supply Enable Pin"
            default 33
            help
                GPIO pin for solder supply stepper ENABLE signal (D33 - Extruder)
    endmenu

    menu "Soldering Iron Configuration"
        config SOLDERING_IRON_PWM_PIN
            int "Soldering Iron PWM Pin"
            default 22
            help
                GPIO pin for soldering iron PWM control

        config SOLDERING_IRON_PWM_FREQUENCY
            int "PWM Frequency (Hz)"
            default 1000
            help
                PWM frequency for soldering iron control

        config SOLDERING_IRON_MAX_TEMP
            int "Maximum Temperature (°C)"
            default 450
            help
                Maximum allowed temperature for soldering iron

        config SOLDERING_IRON_DEFAULT_TEMP
            int "Default Temperature (°C)"
            default 350
            help
                Default temperature setting for soldering iron
    endmenu

    menu "Temperature Sensor Configuration"
        config TEMP_SENSOR_ADC_CHANNEL
            int "ADC Channel"
            default 0
            range 0 7
            help
                ADC1 channel for temperature reading (AD8495 output)

        config TEMP_SENSOR_SAMPLES
            int "Number of Samples"
            default 10
            help
                Number of ADC samples to average for temperature reading
    endmenu

    menu "Web Server Configuration"
        config WEB_SERVER_PORT
            int "HTTP Server Port"
            default 80
            help
                Port for HTTP web server

        config WEB_SERVER_MAX_HANDLERS
            int "Maximum URI Handlers"
            default 20
            help
                Maximum number of URI handlers for web server
    endmenu



endmenu
```

## sdkconfig.defaults
```kconfig
# @file sdkconfig.defaults
# @brief Default SDK configuration for the project
#
# Provides default values for ESP-IDF configuration options.

# Partition table
CONFIG_PARTITION_TABLE_CUSTOM=y
CONFIG_PARTITION_TABLE_CUSTOM_FILENAME="partitions.csv"

# FreeRTOS
CONFIG_FREERTOS_HZ=1000

# Enable C++ exceptions
CONFIG_COMPILER_CXX_EXCEPTIONS=y

# Stack size
CONFIG_ESP_MAIN_TASK_STACK_SIZE=8192

# WiFi
CONFIG_ESP32_WIFI_STATIC_RX_BUFFER_NUM=10
CONFIG_ESP32_WIFI_DYNAMIC_RX_BUFFER_NUM=32
CONFIG_ESP32_WIFI_DYNAMIC_TX_BUFFER_NUM=32

# LWIP
CONFIG_LWIP_MAX_SOCKETS=10
```
